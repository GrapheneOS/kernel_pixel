## private/google-modules/bms/test/Kconfig
```kconfig
# SPDX-License-Identifier: GPL-2.0-or-later

config GOOGLE_TTF_TEST
	tristate "Google TTF test suite"
	depends on KUNIT
	default KUNIT_ALL_TESTS
	help
	  Enables KUnit unit testing for the TTF module in GBMS.
	  TTF calculates remaining charging duration using adapter power limits, battery
	  health status, SOC thresholds, and CCCM temperature tables. The test suite
	  validates SOC time estimation, battery current reductions, adapter power constraints,
	  and invalid input error handling. Say Y or M to build the test suite as `google_ttf_test`.

config GOOGLE_BATTERY_TTF_TESTS
	tristate "Google Battery TTF tests"
	depends on KUNIT
	default KUNIT_ALL_TESTS
	help
	  Enables KUnit unit testing for gbatt_get_ttf in Google Battery driver.
	  gbatt_get_ttf coordinates remaining charging time reporting between the TTF
	  estimation algorithm and fuel gauge calculations. The test suite validates google_battery
	  integration with TTF algorithm. Say Y or M to build the test suite as
	  `google_battery_ttf_tests`.
```

## private/google-modules/radio/mediatek/t900/wwan/tmi3/make/malibu_defconfig
```kconfig
# Keep sorted

#
# Vendor native features
#
CONFIG_MTK_DATA_CPU_LOADING_OPTIMIZE=y
CONFIG_MTK_DEVLINK=y
CONFIG_MTK_DEVLINK_LOGDUMP_SUPPORT=y
CONFIG_MTK_HOST_DRV_WWAN_SUPPORT=y
CONFIG_MTK_MEMLOG_EVENT_SUPPORT=y
CONFIG_MTK_WWAN_PWRCTL_SUPPORT=y

#
# Google customized features
#
CONFIG_GOOGLE_ASPM_CONTROL=y
CONFIG_GOOGLE_DIRECT_COMPLETE_SUPPORT=y
CONFIG_GOOGLE_WWAN_PKT_PRIO=y

#
# Issue mitigation or workaround
#
CONFIG_GOOGLE_ATR_WRITE_RETRY=y
CONFIG_GOOGLE_LINK_DOWN_MMIO_PROTECT=y
CONFIG_GOOGLE_MHCCIF_LINK_ERROR_REPORTING=y

#
# Debug patch
#
CONFIG_GOOGLE_BAR23_ATR_DEBUG=y
CONFIG_GOOGLE_CLDMA1Q4_USR_CNT_DEBUG=y
CONFIG_GOOGLE_LINK_ERROR_DEBUG=y
CONFIG_GOOGLE_SEQ_NUM_ORDER_DEBUG=y
```

## private/google-modules/radio/mediatek/t900/wwan/tmi3/pcie/customize/google/Kconfig
```kconfig
# SPDX-License-Identifier: GPL-2.0-only

config GOOGLE_MD2AP_WAKEUP_MONITOR
	bool "MD-to-AP wakeup monitor"
	depends on ARCH_GOOGLE
	help
	  Enable MD-to-AP wakeup monitor feature to pinpoint wakeup
	  packet and expose the wakeup reason to user space via sysfs.

config GOOGLE_MODEM_CDD
	bool "Crash Debug Dump reporting"
	depends on GOOGLE_CRASH_DEBUG_DUMP
	help
	  Enable modem status reporting for Crash Debug Dump feature.
	  This can provide a quick glance of modem status when device
	  enters ramdump mode.

config GOOGLE_MODEM_DATA_AFFINITY
	bool "Google custom CPU affinity"
	depends on GOOGLE_MODEM_DATA_EXT
	help
	  Use Google's custom CPU affinity tables instead of vendor defaults.
	  Includes a runtime size check to ensure safety.

config GOOGLE_MODEM_DATA_EXT
	bool "Google data plane extensions"
	depends on ARCH_GOOGLE
	default y
	help
	  Gatekeeping option for all Google-specific data plane
	  enhancements.

config GOOGLE_MODEM_DATA_FAST_DMA_SYNC
	bool "Fast DMA sync optimization"
	depends on GOOGLE_MODEM_DATA_EXT
	help
	  Enable fast DMA sync when the page address is already known.

config GOOGLE_MODEM_DATA_LRO_SIZE_LIMIT
	bool "Limit RX LRO packets max size"
	depends on GOOGLE_MODEM_DATA_EXT
	help
	  Limit max Large Receive Offload (LRO) size to avoid
	  skb_over_panic on certain network device (e.g. USB NCM).

config GOOGLE_MODEM_SOC_BW_QOS
	bool "Modem SoC QoS for DDR bandwidth"
	depends on GOOGLE_MODEM_DATA_EXT
	help
	  Enable SoC QoS and DDR bandwidth voting.

config GOOGLE_WWAN_MLLB
	bool "WWAN Modem Low-Level Benchmark (MLLB) Support"
	depends on ARCH_GOOGLE
	help
	  This feature provides a high-performance raw data sink for benchmarking
	  the WWAN modem data plane. It intercepts packets at the WWAN receive
	  layer to measure raw throughput and provides a 256-second history log.
```
